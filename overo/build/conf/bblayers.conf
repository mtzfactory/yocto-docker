## overo/build/conf/bblayers.conf
```bitbake
# LAYER_CONF_VERSION is increased each time build/conf/bblayers.conf
# changes incompatibly
LCONF_VERSION = "6"

BBPATH = "${TOPDIR}"
BBFILES ?= ""
BBLAYERS ?= " \
  ${TOPDIR}/../poky/meta \
  ${TOPDIR}/../poky/meta-yocto \
  ${TOPDIR}/../poky/meta-openembedded/meta-gnome \
  ${TOPDIR}/../poky/meta-openembedded/meta-oe \
  ${TOPDIR}/../poky/meta-openembedded/meta-ruby \
  ${TOPDIR}/../poky/meta-openembedded/meta-xfce \
  ${TOPDIR}/../poky/meta-openembedded/meta-systemd \
  ${TOPDIR}/../poky/meta-openembedded/meta-networking \
  ${TOPDIR}/../poky/meta-openembedded/meta-multimedia \
  ${TOPDIR}/../poky/meta-gumstix \
  ${TOPDIR}/../poky/meta-gumstix-extras \
  ${TOPDIR}/../poky/meta-ti \
  ${TOPDIR}/../poky/meta-qt5 \
  ${TOPDIR}/../poky/meta-ros \
  "
```
